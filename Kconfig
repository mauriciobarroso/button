## Kconfig
```kconfig
menu "Button Configuration"
	
    config BUTTON_NUM_MAX
        int "Button maximum number"
        default 4
        help
        	Set maximum number of buttons allowed.

    config BUTTON_TICK_MS
        int "Button Tick"
        default 10
        help
          Set the button FSM tick time in ms.

    menu "Dispatcher"
        config BUTTON_TASK_PRIORITY
            int "Button task priority"
            default 1
            help
              Set the dispatcher task priority.

        config BUTTON_TASK_STACK_SIZE
            int "Button task stack size"
            default 4096
            help
              Set the dispatcher task stack size.

        config BUTTON_QUEUE_LEN
            int "Button queue lenght"
            default 10
            help
              Set the dispatcher queue items length.
    endmenu

endmenu
```

## examples/print_press_type/esp32/main/Kconfig.projbuild
```kconfig
menu "Application Configuration"
	config BUTTON_GPIO_NUM
		int "GPIO number"
		default 0
endmenu
```
